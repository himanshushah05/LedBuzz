#include <FirebaseESP8266.h>  // Install Firebase ESP8266 library
#include <ESP8266WiFi.h>    // Install DHT11 Library and Adafruit Unified Sensor Library
#include <ESPAsyncTCP.h>
#include <ESPAsyncWebServer.h>
#include <NTPClient.h>
#include <WiFiUdp.h>

#define FIREBASE_HOST "DB_Link" //Without http:// or https:// schemes
#define FIREBASE_AUTH "Auth_Key"
#define WIFI_SSID "SSID"
#define WIFI_PASSWORD "PASSWORD"

WiFiUDP ntpUDP;
NTPClient timeClient(ntpUDP, "pool.ntp.org");

int LED_PINS[] = {16,5,4,0,2,14,12,13};    
int INPUT_PIN = 10;
int CUSTOM_CHAR_LENGTH = 5;
int LED_COUNT = 8;
int k;
String uid="Your User ID on App";

int pins[10]={16,5,4,0,2,14,12,13,15,1};
long times[20];
int rpm=300;
unsigned long prevMillis=0;
//Define FirebaseESP8266 data object
FirebaseData firebaseData;
FirebaseData RTDBData;
FirebaseJson json;


char Display_String[] = "Mayank";
String subs[20];
String sliderValue = "369";

const char* PARAM_INPUT = "value";

// Create AsyncWebServer object on port 80
AsyncWebServer server(80);

const char index_html[] PROGMEM = R"rawliteral(
<!DOCTYPE HTML><html>
<head>
  <meta name="viewport" content="width=device-width, initial-scale=1">
  <title>LedBuzz</title>
  <style>
    html {font-family: Arial; display: inline-block; text-align: center; background-color: #1f2833;color: white;}
    h1 {font-size: 3rem; background-color:#66fcf1 ; color: #1f2833; text-shadow:2px 2px 5px white;}
    h2 {font-size: 2.3rem; text-shadow:1px 1px 5px #66fcf1;}
    p {font-size: 1.9rem; color: #66fcf1;}
    body {max-width: 400px; margin:0px auto; padding-bottom: 25px;}
    .slider { -webkit-appearance: none; margin: 14px; width: 360px; height: 25px; background: #66fcf1;
      outline: none; -webkit-transition: .2s; transition: opacity .2s; border-radius: 5px;}
    .slider::-webkit-slider-thumb {-webkit-appearance: none; appearance: none; width: 35px; height: 35px; background: #003249; cursor: pointer;}
    .slider::-moz-range-thumb { width: 35px; height: 35px; background: #1f2833; cursor: pointer;border-radius: 5px; } 
  </style>
</head>
<body>
   <h1>LedBuzz</h1> 
  <h2>Motor RPM control</h2>
  <p><span id="textSliderValue">%SLIDERVALUE%</span></p>
  <p><input type="range" oninput="updateSliderPWM(this)" id="pwmSlider" min="100" max="370" value="%SLIDERVALUE%" step="1" class="slider"></p>
<script>
function updateSliderPWM(element) {
  var sliderValue = document.getElementById("pwmSlider").value;
  document.getElementById("textSliderValue").innerHTML = sliderValue;
  console.log(sliderValue);
  var xhr = new XMLHttpRequest();
  xhr.open("GET", "/slider?value="+sliderValue, true);
  xhr.send();
}
</script>
</body>
</html>
)rawliteral";

// Replaces placeholder with button section in your web page
String processor(const String& var){
  //Serial.println(var);
  if (var == "SLIDERVALUE"){
    return sliderValue;
  }
  return String();
}

const unsigned char CUSTOM_CHAR[95][5] = {
         {0x00,0x00,0x00,0x00,0x00},   //   0x20 32
         {0x00,0x00,0x6f,0x00,0x00},   // ! 0x21 33
         {0x00,0x07,0x00,0x07,0x00},   // " 0x22 34
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         {0x04,0x02,0x04,0x08,0x04},   // ~ 0x7e 126
     };

void PRINT_STRING(char data) {
    
    if (data < 32 || data > 126)
    {
      data = 32;
    }
    data -= 32;
    
    for (int x=CUSTOM_CHAR_LENGTH-1; x>-1; x--) 
    {
      byte temp_data = CUSTOM_CHAR[data][x];
      for (int y=0; y<LED_COUNT; y++) 
      {
        digitalWrite(LED_PINS[y], bitRead(temp_data,y));
      }
      delayMicroseconds(500);
    }
    
    for ( k = 0; k < LED_COUNT; k++)
    {
      digitalWrite(LED_PINS[k] , LOW);
    }
    delayMicroseconds(250);
  
}  

void getSubName() {
  json=RTDBData.to<FirebaseJson>();
  size_t len = json.iteratorBegin();
  String key,value = "";
  int type = 0;
  int count=0;
  for (size_t i1 = 0; i1 < len; i1+=5) {
      json.iteratorGet(i1, type, key, value);
          subs[count]=key;
          Serial.println(subs[count]);
          count+=1;
    }
    json.iteratorEnd();
}

void checkTime() {
  for(int i=0;i<10;i++)
  {
    if(subs[i]!="")
    {
    while(Firebase.getDouble(firebaseData, "/users/"+uid+"/Data/"+subs[i]+"/time")!=1)
    {}
      times[i]=firebaseData.to<double>()/1000;
      //Serial.println(firebaseData.to<double>()/1000);
      Serial.print("Time: ");
      Serial.print(times[i]);
      Serial.print(" Index : ");
      Serial.println(i);
    }
  }
}

void setup() {
  for (int i = 0; i < LED_COUNT; i++)
  {
     pinMode(LED_PINS[i], OUTPUT);    
  }
  Serial.begin(115200);
  WiFi.begin(WIFI_SSID, WIFI_PASSWORD);
  Serial.print("Connecting to Wi-Fi");
  while (WiFi.status() != WL_CONNECTED)
  {
    Serial.print(".");
    delay(300);
  }
  Serial.println();
  Serial.print("Connected with IP: ");
  Serial.println(WiFi.localIP());
  Serial.println();
  timeClient.begin();
  timeClient.setTimeOffset(19800);
  
  Firebase.begin(FIREBASE_HOST, FIREBASE_AUTH);
  Firebase.reconnectWiFi(true);
  
  Serial.println(sliderValue.toInt());
  // Route for root / web page
  server.on("/", HTTP_GET, [](AsyncWebServerRequest *request){
    request->send_P(200, "text/html", index_html, processor);
  });

  // Send a GET request to <ESP_IP>/slider?value=<inputMessage>
  server.on("/slider", HTTP_GET, [] (AsyncWebServerRequest *request) {
  String inputMessage;
  // GET input1 value on <ESP_IP>/slider?value=<inputMessage>
  if (request->hasParam(PARAM_INPUT)) {
     inputMessage = request->getParam(PARAM_INPUT)->value();
     sliderValue = inputMessage;
   }
   else {
      inputMessage = "No message sent";
    }
   Serial.println(inputMessage);
   request->send(200, "text/plain", "OK");
  });
  
  // Start server
  server.begin();
  //pinMode(sensorPin, INPUT);

  for(int i=0;i<10;i++)
  {
    subs[i]="";
  }
  for(int i=0;i<10;i++)
  {
    times[i]=0;
  }
}

void loop(){
    rpm=sliderValue.toInt();
    timeClient.update();
    unsigned long epochTime = timeClient.getEpochTime();
    for(int i=0;i<10;i++)
    {
      if(epochTime==times[i])
      (subs[i]+" "+"Class Alert").toCharArray(Display_String,200);
    }
//    Serial.print("RPM: ");
//    Serial.println(rpm);
    if(millis()-prevMillis>=(2000*3.142)/(0.10472*rpm))
    {
      prevMillis=millis();
      //Do nothing. EAT 5-Star
      //Print Now   
      for (int a=sizeof(Display_String)-1; a>-1; a--)
      {
       PRINT_STRING(Display_String[a]);
      }
    }
    else
    { 
      if (Firebase.getString(RTDBData, "/users/"+uid+"/Data/"))
      {
        Serial.println(RTDBData.stringData());
      }
      getSubName();
      checkTime();
    } 
    delay(0);
}  
